## config/boards/shields/harsha/Kconfig.defconfig
```kconfig
if SHIELD_HARSHA_LEFT

config ZMK_KEYBOARD_NAME
    default "Harsha's Corne"

config ZMK_SPLIT_ROLE_CENTRAL
    default y

endif

if SHIELD_HARSHA_LEFT || SHIELD_HARSHA_RIGHT

config ZMK_SPLIT
    default y

endif
```

## config/boards/shields/harsha/Kconfig.shield
```kconfig
config SHIELD_HARSHA_LEFT
    def_bool $(shields_list_contains,harsha_left)

config SHIELD_HARSHA_RIGHT
    def_bool $(shields_list_contains,harsha_right)
```
